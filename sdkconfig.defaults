## sdkconfig.defaults
```kconfig
# Default to 921600 baud when flashing and monitoring device
CONFIG_ESPTOOLPY_BAUD_921600B=y
CONFIG_ESPTOOLPY_BAUD=921600
CONFIG_ESPTOOLPY_COMPRESSED=y
CONFIG_ESPTOOLPY_MONITOR_BAUD_115200B=y
CONFIG_ESPTOOLPY_MONITOR_BAUD=115200
CONFIG_ESPTOOLPY_FLASHSIZE_8MB=y

#enable BT
CONFIG_BT_ENABLED=y
CONFIG_BT_NIMBLE_ENABLED=y

#enable lwip ipv6 autoconfig
CONFIG_LWIP_IPV6_AUTOCONFIG=y

# Use a custom partition table
CONFIG_PARTITION_TABLE_CUSTOM=y
CONFIG_PARTITION_TABLE_FILENAME="partitions.csv"
CONFIG_PARTITION_TABLE_OFFSET=0xC000

# Enable chip shell
CONFIG_ENABLE_CHIP_SHELL=y

#enable lwIP route hooks
CONFIG_LWIP_HOOK_IP6_ROUTE_DEFAULT=y
CONFIG_LWIP_HOOK_ND6_GET_GW_DEFAULT=y

# Button
CONFIG_BUTTON_PERIOD_TIME_MS=20
CONFIG_BUTTON_LONG_PRESS_TIME_MS=5000

# Disable DS Peripheral
CONFIG_ESP_SECURE_CERT_DS_PERIPHERAL=n

CONFIG_LWIP_LOCAL_HOSTNAME="yogyui-dual-rs485-conv"
CONFIG_LWIP_MAX_SOCKETS=16
CONFIG_LWIP_IRAM_OPTIMIZATION=y
CONFIG_LWIP_NETIF_LOOPBACK=y
# CONFIG_LWIP_LOOPBACK_MAX_PBUFS=1

#
# WiFi AP Options
#
CONFIG_ESP_WIFI_SOFTAP_SUPPORT=y
CONFIG_ENABLE_WIFI_AP=y
CONFIG_WIFI_AP_SSID_PREFIX="YOGYUI-"
CONFIG_WIFI_AP_CHANNEL=1
CONFIG_WIFI_AP_MAX_STATIONS=8
CONFIG_WIFI_AP_BEACON_INTERVAL=100
CONFIG_WIFI_AP_IDLE_TIMEOUT=120000
CONFIG_ESP32_WIFI_ENABLE_WPA3_SAE=n
# end of WiFi AP Options

#
# SPIFFS Cache Configuration
#
CONFIG_SPIFFS_OBJ_NAME_LEN=64

#
# HTTP Server
# Prevent "Header fields are too long for server to interpret" Issue
#
CONFIG_HTTPD_MAX_REQ_HDR_LEN=1024

# High performance WiFi
CONFIG_ESP32_WIFI_STATIC_RX_BUFFER_NUM=6
CONFIG_ESP32_WIFI_DYNAMIC_RX_BUFFER_NUM=24
CONFIG_ESP32_WIFI_DYNAMIC_TX_BUFFER_NUM=24
CONFIG_ESP32_WIFI_RX_BA_WIN=12
CONFIG_LWIP_TCP_SND_BUF_DEFAULT=24576
CONFIG_LWIP_TCP_WND_DEFAULT=24576

# Compiler options
CONFIG_COMPILER_OPTIMIZATION_SIZE=y
CONFIG_COMPILER_OPTIMIZATION_ASSERTIONS_DISABLE=y
CONFIG_COMPILER_OPTIMIZATION_CHECKS_SILENT=y
CONFIG_ESP_ERR_TO_NAME_LOOKUP=n

#
# ESP32-specific
#
CONFIG_ESP32_REV_MIN_3=y
CONFIG_ESP32_REV_MIN=3

#
# ADC-Calibration
#
CONFIG_ADC_CAL_EFUSE_TP_ENABLE=n
CONFIG_ADC_CAL_EFUSE_VREF_ENABLE=n
CONFIG_ADC_CAL_LUT_ENABLE=n

#
# Newlib
#
# CONFIG_NEWLIB_NANO_FORMAT=y

#
#
#
CONFIG_ESP_TASK_WDT_CHECK_IDLE_TASK_CPU0=n
CONFIG_ESP_TASK_WDT_CHECK_IDLE_TASK_CPU1=n

#
# Optimize IRAM usage
#
CONFIG_FREERTOS_PLACE_FUNCTIONS_INTO_FLASH=y
CONFIG_FREERTOS_PLACE_SNAPSHOT_FUNS_INTO_FLASH=y
CONFIG_RINGBUF_PLACE_FUNCTIONS_INTO_FLASH=y
CONFIG_RINGBUF_PLACE_ISR_FUNCTIONS_INTO_FLASH=y

#
# Log output
#
CONFIG_LOG_DEFAULT_LEVEL_INFO=y
```
